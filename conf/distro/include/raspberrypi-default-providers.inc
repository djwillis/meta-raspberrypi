## conf/distro/poky-raspberrypi.conf
```bitbake
require conf/distro/poky.conf
require conf/distro/include/raspberrypi-default-versions.inc
require conf/distro/include/raspberrypi-default-providers.inc

# There is no libav in poky
# Systemd is not yet in poky
# rpi-zram-service is a systemd service
# and it needs systemd
BBMASK = "libav|rpi-zram-service"
```

## conf/distro/poky.conf
```bitbake
DISTRO_FEATURES = "alsa argp apm bluetooth ext2 irda largefile sysvinit usbgadget usbhost wifi xattr nfs zeroconf pci nfc ${DISTRO_FEATURES_LIBC}"

DISTRO_FEATURES_BACKFILL_CONSIDERED = "pulseaudio systemd"
```

## conf/machine/include/rpi-default-providers.inc
```bitbake
# RaspberryPi BSP default providers

PREFERRED_PROVIDER_virtual/kernel = "linux-raspberrypi"
PREFERRED_PROVIDER_u-boot = "u-boot-rpi"

PREFERRED_PROVIDER_virtual/egl ?= "vc-graphics-hardfp"
PREFERRED_PROVIDER_virtual/libgles1 ?= "vc-graphics-hardfp"
PREFERRED_PROVIDER_virtual/libgles2 ?= "vc-graphics-hardfp"

PREFERRED_PROVIDER_virtual/libgl ?= "mesa-gl"
PREFERRED_PROVIDER_virtual/mesa ?= "mesa-gl"

PREFERRED_PROVIDER_jpeg = "libjpeg-turbo"
PREFERRED_PROVIDER_jpeg-native = "libjpeg-turbo-native"

PREFERRED_PROVIDER_virtual/xserver = "xserver-xorg"
PREFERRED_PROVIDER_xserver-nodm-init = "lxdm"
```

## conf/machine/include/rpi-default-versions.inc
```bitbake
# RaspberryPi BSP default versions

PREFERRED_VERSION_linux-raspberrypi ?= "3.10.%"
PREFERRED_VERSION_libvorbis ?= "1.3.3"
```
